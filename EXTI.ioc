# file: EXTI.ioc
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Mcu.Family=STM32F4
Mcu.Name=STM32F411V(C-E)Tx
Mcu.Package=LQFP100
NVIC.PriorityGroup=NVIC_PRIORITYGROUP_4
PA13.Mode=Serial_Wire
PA13.Signal=SYS_JTMS-SWDIO
PA14.Mode=Serial_Wire
PA14.Signal=SYS_JTCK-SWCLK
ProjectManager.HeapSize=0x200
ProjectManager.StackSize=0x400
ProjectManager.TargetToolchain=STM32CubeIDE
RCC.AHBFreq_Value=16000000
RCC.APB1Freq_Value=16000000
RCC.APB2Freq_Value=16000000
RCC.CortexFreq_Value=16000000
RCC.HSE_VALUE=25000000
RCC.HSI_VALUE=16000000
RCC.LSE_VALUE=32768
RCC.SYSCLKFreq_VALUE=16000000
RCC.VCOOutputFreq_Value=192000000
board=custom

// file: Core/Src/main.c
/* USER CODE BEGIN Header */
/**
  ******************************************************************************
  * @file           : main.c
  * @brief          : Main program body
  ******************************************************************************
  * @attention
  *
  * <h2><center>&copy; Copyright (c) 2021 STMicroelectronics.
  * All rights reserved.</center></h2>
  *
  * This software component is licensed by ST under BSD 3-Clause license,
  * the "License"; You may not use this file except in compliance with the
  * License. You may obtain a copy of the License at:
  *                        opensource.org/licenses/BSD-3-Clause
  *
  ******************************************************************************
  */
/* USER CODE END Header */
#include "main.h"

void SystemClock_Config(void);
static void MX_GPIO_Init(void);

/* USER CODE BEGIN 0 */
void MyHandler()
{
	__asm("nop");
}
/* USER CODE END 0 */

int main(void)
{

  /* MCU Configuration--------------------------------------------------------*/

  /* Reset of all peripherals, Initializes the Flash interface and the Systick. */
  HAL_Init();

  /* Configure the system clock */
  SystemClock_Config();

  /* Initialize all configured peripherals */
  MX_GPIO_Init();
  /* USER CODE BEGIN 2 */
  __HAL_RCC_GPIOD_CLK_ENABLE();

  uint32_t* D_MODER = (uint32_t*)(0x40020C00);
  *D_MODER &= ~(0b11111111<<24);
  *D_MODER |= (0b01010101<<24);
  //uint32_t* D_OTYPER = (uint32_t*)(0x4002000C);
  //*D_OTYPER &= ~(0b1111<<12);
  uint32_t* D_ODR = (uint32_t*)(0x40020C14);

  __HAL_RCC_GPIOA_CLK_ENABLE();
  uint32_t* A_MODER = (uint32_t*)(0x40020000);
  *A_MODER &= ~0b11;
  //uint32_t* A_IDR = (uint32_t*)(0x40020010);

  uint32_t* SYSCFG_EXTICR1 = (uint32_t*)(0x40013808);
  *SYSCFG_EXTICR1 &= ~0b1111;

  uint32_t* EXTI_IMR = (uint32_t*)(0x40013C00);
  *EXTI_IMR |= 0b1;

  uint32_t* EXTI_FTSR = (uint32_t*)(0x40013C0C);
  *EXTI_FTSR |= 0b1;
  //uint32_t* EXTI_RTSR = (uint32_t*)(0x40013C08);
  //*EXTI_RTSR |= 0b1;

  uint32_t* NVIC_ISER0 = (uint32_t*)(0xE000E100);
  *NVIC_ISER0 |= (0b1<<6);

  uint32_t* VTOR = (uint32_t*)(0xE00ED08);
  *VTOR = 0x2000000;

  memcpy(0x2000000,0x0800000,396);

  uint32_t* px = (uint32_t*)(0x20000058);
  *px = (int)MyHandler|1;

  /* USER CODE END 2 */

  /* Infinite loop */
  while (1)
  {
	  *D_ODR |= (0b1<<12);
	  HAL_Delay(1000);
	  *D_ODR &= ~0xFFFF;

	  *D_ODR |= (0b1<<13);
	  HAL_Delay(1000);
	  *D_ODR &= ~0xFFFF;

	  *D_ODR |= (0b1<<14);
	  HAL_Delay(1000);
	  *D_ODR &= ~0xFFFF;

	  *D_ODR |= (0b1<<15);
	  HAL_Delay(1000);
	  *D_ODR &= ~0xFFFF;

  }
}

void SystemClock_Config(void)
{
  RCC_OscInitTypeDef RCC_OscInitStruct = {0};
  RCC_ClkInitTypeDef RCC_ClkInitStruct = {0};

  /** Configure the main internal regulator output voltage
  */
  __HAL_RCC_PWR_CLK_ENABLE();
  __HAL_PWR_VOLTAGESCALING_CONFIG(PWR_REGULATOR_VOLTAGE_SCALE1);
  /** Initializes the RCC Oscillators according to the specified parameters
  * in the RCC_OscInitTypeDef structure.
  */
  RCC_OscInitStruct.OscillatorType = RCC_OSCILLATORTYPE_HSI;
  RCC_OscInitStruct.HSIState = RCC_HSI_ON;
  RCC_OscInitStruct.HSICalibrationValue = RCC_HSICALIBRATION_DEFAULT;
  RCC_OscInitStruct.PLL.PLLState = RCC_PLL_NONE;
  if (HAL_RCC_OscConfig(&RCC_OscInitStruct) != HAL_OK)
  {
    Error_Handler();
  }
  /** Initializes the CPU, AHB and APB buses clocks
  */
  RCC_ClkInitStruct.ClockType = RCC_CLOCKTYPE_HCLK|RCC_CLOCKTYPE_SYSCLK
                              |RCC_CLOCKTYPE_PCLK1|RCC_CLOCKTYPE_PCLK2;
  RCC_ClkInitStruct.SYSCLKSource = RCC_SYSCLKSOURCE_HSI;
  RCC_ClkInitStruct.AHBCLKDivider = RCC_SYSCLK_DIV1;
  RCC_ClkInitStruct.APB1CLKDivider = RCC_HCLK_DIV1;
  RCC_ClkInitStruct.APB2CLKDivider = RCC_HCLK_DIV1;

  if (HAL_RCC_ClockConfig(&RCC_ClkInitStruct, FLASH_LATENCY_0) != HAL_OK)
  {
    Error_Handler();
  }
}

static void MX_GPIO_Init(void)
{

  /* GPIO Ports Clock Enable */
  __HAL_RCC_GPIOA_CLK_ENABLE();

}

/* USER CODE BEGIN 4 */
//void EXTI0_IRQHandler()
//  {
//	  __asm("nop");
//	  uint32_t* EXTI_PR = (uint32_t*)(0x40013C14);
//	  *EXTI_PR |= 1;
//  }
/* USER CODE END 4 */

void Error_Handler(void)
{
  __disable_irq();
  while (1)
  {
  }
}

/************************ (C) COPYRIGHT STMicroelectronics *****END OF FILE****/
